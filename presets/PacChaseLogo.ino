#include <avr/pgmspace.h>
#include "FastLED.h"

#define DATA_PIN 3   // wimos pin 2(D4)
#define NUM_LEDS 256
#define NUM_ROWS 16
#define NUM_COLS 16
#define BRIGHTNESS 20

static CRGB leds[NUM_LEDS];


const uint32_t LogoPalette[] PROGMEM = {
  0x00000000, 0x0000014a, 0x00ffb500, 0x00ce9000, 0x00e49f00, 0x00ffad00, 0x00d69400, 0x002b1e00, 0x008a5f00, 0x00f7ad00, 0x00a77400, 0x00bf8600, 0x00efa900, 0x00593b00, 0x001c1400, 0x00ff806f, 0x00100800
};
const byte LogoSprite[] PROGMEM = {

  0, 1, 1, 1, 1, 1, 1, 1, 1, 1, 1, 1,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 1,
  2, 3, 2, 4, 2, 4, 5, 6, 7, 0, 0, 0,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 0,
  5, 4, 5, 5, 5, 5, 5, 2, 6, 7, 0, 0,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 0,
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  0, 0, 0, 0, 0, 0, 0, 0, 0, 0, 0, 0,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 0,
};




const uint32_t PacPaletteM[] PROGMEM = {
  0x0000014a, 0x00000000, 0x00286cfe, 0x00fe9d06, 0x00d763bd, 0x00ff0000, 0x00ffff00, 0x00dedeff, 0x002121ff, 0x00ff806f
};

const byte PacSpriteM[] PROGMEM = {

  0, 0, 0, 0, 0, 0, 0, 0, 0, 0, 0, 0,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 0,
  1, 1, 1, 1, 1, 1, 1, 1, 1, 1, 1, 1,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 1,
  1, 1, 1, 1, 1, 1, 1, 1, 1, 1, 1, 1,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 1,
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  0, 0, 0, 0, 0, 0, 0, 0, 0, 0, 0, 0,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 0,
};






const uint32_t PacPaletteT[] PROGMEM = {
  0x0000014a, 0x00000000, 0x00080504, 0x00286cfe, 0x00fe9d06, 0x00d763bd, 0x00ff0000, 0x00ffff00, 0x00090900, 0x00dedeff, 0x002121ff, 0x00ffb7ae
};

const byte PacSpriteT[] PROGMEM = {
  0, 0, 0, 0, 0, 0, 0, 0, 0, 0, 0, 0,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 0,
  1, 1, 1, 1, 1, 1, 1, 1, 1, 1, 1, 1,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 1,
  1, 1, 1, 1, 1, 1, 1, 1, 1, 1, 1, 1,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 1,
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  0, 0, 0, 0, 0, 0, 0, 0, 0, 0, 0, 0,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 0,
};

const uint32_t PacPaletteB[] PROGMEM = {
  0x0000014a, 0x00000000, 0x00080504, 0x00286cfe, 0x00fe9d06, 0x00d763bd, 0x00ff0000, 0x00ffff00, 0x00dedeff, 0x002121ff, 0x00ffb7ae
};

const byte PacSpriteB[] PROGMEM = {
  0, 0, 0, 0, 0, 0, 0, 0, 0, 0, 0, 0,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 0,
  1, 1, 1, 1, 1, 1, 1, 1, 1, 1, 1, 1,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 1,
  1, 1, 1, 1, 1, 1, 1, 1, 1, 1, 1, 1,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 1,
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  0, 0, 0, 0, 0, 0, 0, 0, 0, 0, 0, 0,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 0,
};




const uint32_t PacPaletteM2[] PROGMEM = {
  0x0000014a, 0x00000000, 0x000706e4, 0x00ffff00, 0x00dedeff, 0x00e6867a
};
const byte PacSpriteM2[] PROGMEM = {
  0, 0, 0, 0, 0, 0, 0, 0, 0, 0, 0, 0,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 0,
  1, 1, 1, 1, 1, 1, 1, 1, 1, 1, 1, 1,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 1,
  1, 1, 1, 1, 1, 1, 1, 1, 1, 1, 1, 1,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 1,
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  0, 0, 0, 0, 0, 0, 0, 0, 0, 0, 0, 0,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 0,
};








const uint32_t PacPaletteB2[] PROGMEM = {

  0x0000014a, 0x00000000, 0x00080504, 0x000706e4, 0x00ffff00, 0x00dedeff, 0x00e6867a
};
const byte PacSpriteB2[] PROGMEM = {
  0, 0, 0, 0, 0, 0, 0, 0, 0, 0, 0, 0,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 0,
  1, 1, 1, 1, 1, 1, 1, 1, 1, 1, 1, 1,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 1,
  1, 1, 1, 1, 1, 1, 1, 1, 1, 1, 1, 1,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 1,
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  0, 0, 0, 0, 0, 0, 0, 0, 0, 0, 0, 0,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 0,
};


const uint32_t PacPaletteT2[] PROGMEM = {
  0x0000014a, 0x00000000, 0x00080504, 0x00d1d0cf, 0x000706e4, 0x00ffff00, 0x00dedeff, 0x00090900, 0x00d2240e, 0x00e6867a
};
const byte PacSpriteT2[] PROGMEM = {
  0, 0, 0, 0, 0, 0, 0, 0, 0, 0, 0, 0,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 0,
  1, 1, 1, 1, 1, 1, 1, 1, 1, 1, 1, 1,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 1,
  1, 1, 1, 1, 1, 1, 1, 1, 1, 1, 1, 1,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 1,
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  0, 0, 0, 0, 0, 0, 0, 0, 0, 0, 0, 0,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 0,
};


const int logoSpriteWidth = 112;
const int logoSpriteHeight = 32;

/*
  Notes for Kevin

  Images must NOT have even lines reversed (this makes math too complicated)

  Function reverses even lines as it goes.

  % is modulus which wraps values 0 % 2 = 0, 1 % 2 = 2, 3 % 2 = 0 key to keeping things in check.

*/
// Function to render part of sprite
void renderPartOfSprite(const byte sprite[256], const uint32_t palette[], int spriteWidth, int spriteHeight, int offsetX, int offsetY) {
  for(int x = 0; x < NUM_COLS; x++) {
    for(int y = 0; y < NUM_ROWS; y++) {
      bool isEvenRow = y % 2 == 0;
      int position = (y + offsetY) * spriteWidth;
      if (isEvenRow) {
        position += ((offsetX + (NUM_COLS - x - 1)) % spriteWidth); // Backwards
      } else {
        position += ((offsetX + x) % spriteWidth); // Forwards
      }
      position = position % (spriteWidth * spriteHeight); // Wrap around

      byte index = pgm_read_byte(&(sprite[position]));
      uint32_t rgb = pgm_read_dword(&(palette[index]));
      leds[y * NUM_COLS + x] = rgb;
    }
  }
  FastLED.show();
}


void setup() {
  FastLED.addLeds<NEOPIXEL,DATA_PIN>(leds, NUM_LEDS);
  FastLED.setBrightness(BRIGHTNESS);
//  Serial.begin(9600);
}

void loop() {

 

 //  Vertical
  for (int y = 16 ; y > 0; y--) {
    renderPartOfSprite(LogoSprite, LogoPalette, logoSpriteWidth, logoSpriteHeight, 0, y);
    delay(40);
  }
 // Pac Logo
  for (int x = 0; x < logoSpriteWidth - 15; x++) {
    renderPartOfSprite(LogoSprite, LogoPalette, logoSpriteWidth, logoSpriteHeight, x, 0);
    delay(60);
  }



  // Pac Chase
  for (int x = 0; x < logoSpriteWidth -16; x++) {
    renderPartOfSprite(PacSpriteM, PacPaletteM, logoSpriteWidth, logoSpriteHeight, x, 0);
    delay(70); x++;
    renderPartOfSprite(PacSpriteT, PacPaletteT, logoSpriteWidth, logoSpriteHeight, x, 0);
    delay(70); x++;
     renderPartOfSprite(PacSpriteM, PacPaletteM, logoSpriteWidth, logoSpriteHeight, x, 0);
    delay(70); x++;
    renderPartOfSprite(PacSpriteB, PacPaletteB, logoSpriteWidth, logoSpriteHeight, x, 0);
    delay(70);   
  }
  
  // Ghost Chase
  for (int x = logoSpriteWidth - 20; x > 15; x--) {
    renderPartOfSprite(PacSpriteM2, PacPaletteM2, logoSpriteWidth, logoSpriteHeight, x, 0);
    delay(70); x--;
    renderPartOfSprite(PacSpriteT2, PacPaletteT2, logoSpriteWidth, logoSpriteHeight, x, 0);
    delay(70); x--;
     renderPartOfSprite(PacSpriteM2, PacPaletteM2, logoSpriteWidth, logoSpriteHeight, x, 0);
    delay(70); x--;
    renderPartOfSprite(PacSpriteB2, PacPaletteB2, logoSpriteWidth, logoSpriteHeight, x, 0);
    delay(70);   
 
  }

  for(int passtime = 0; passtime < 3; passtime++) {

  //FastLED.clear();

  // Pac Chase
  for (int x = 14; x < logoSpriteWidth -16; x++) {
    renderPartOfSprite(PacSpriteM, PacPaletteM, logoSpriteWidth, logoSpriteHeight, x, 0);
    delay(70); x++;
    renderPartOfSprite(PacSpriteT, PacPaletteT, logoSpriteWidth, logoSpriteHeight, x, 0);
    delay(70); x++;
     renderPartOfSprite(PacSpriteM, PacPaletteM, logoSpriteWidth, logoSpriteHeight, x, 0);
    delay(70); x++;
    renderPartOfSprite(PacSpriteB, PacPaletteB, logoSpriteWidth, logoSpriteHeight, x, 0);
    delay(70);   
  }
  
  // Ghost Chase
  for (int x = logoSpriteWidth - 20; x > 15; x--) {
    renderPartOfSprite(PacSpriteM2, PacPaletteM2, logoSpriteWidth, logoSpriteHeight, x, 0);
    delay(70); x--;
    renderPartOfSprite(PacSpriteT2, PacPaletteT2, logoSpriteWidth, logoSpriteHeight, x, 0);
    delay(70); x--;
     renderPartOfSprite(PacSpriteM2, PacPaletteM2, logoSpriteWidth, logoSpriteHeight, x, 0);
    delay(70); x--;
    renderPartOfSprite(PacSpriteB2, PacPaletteB2, logoSpriteWidth, logoSpriteHeight, x, 0);
    delay(70);   
 
  }
}

}
/*
  // Diagonal
  for (int y = 0; y < pokeySpriteHeight * 3; y++) {
    renderPartOfSprite(pokeySprite, pokeyPalette, pokeySpriteWidth, pokeySpriteHeight, y, y);
    delay(100);
  }

  // Horizontal
  for (int x = 0; x < worldSpriteWidth * 2; x++) {
    renderPartOfSprite(worldSprite, worldPalette, worldSpriteWidth, worldSpriteHeight, x, 0);
    delay(75);
  }
*/
